## CMakeLists.txt
```
#
# Copyright (c) 2018 Nordic Semiconductor ASA
# Copyright (c) 2022 Conexio Technologies, Inc
#
# SPDX-License-Identifier: LicenseRef-Nordic-5-Clause
#

cmake_minimum_required(VERSION 3.20.0)
find_package(Zephyr REQUIRED HINTS $ENV{ZEPHYR_BASE})
project(watchdog)

target_sources(app PRIVATE src/main.c)

zephyr_include_directories(src)

# Include application events and configuration headers
zephyr_library_include_directories(src/watchdog)

# Application sources
add_subdirectory_ifdef(CONFIG_WATCHDOG src/watchdog)
```

## Kconfig
```
#
# Copyright (c) 2020 Nordic Semiconductor ASA
# Copyright (c) 2022 Conexio Technologies, Inc
#
# SPDX-License-Identifier: LicenseRef-Nordic-5-Clause
#

menu "Watchdog Timer"

config APPLICATION_WORKQUEUE_STACK_SIZE
	int "Application workqueue stack size"
	default 4096

config APPLICATION_WORKQUEUE_PRIORITY
	int "Application workqueue priority"
	default SYSTEM_WORKQUEUE_PRIORITY
	
config WATCHDOG_TIMEOUT_MSEC
	int "Watchdog timeout in milliseconds"
	default 60000

endmenu

menu "Zephyr Kernel"
source "Kconfig.zephyr"
endmenu

module = WDTIMER
module-str = WDT
source "${ZEPHYR_BASE}/subsys/logging/Kconfig.template.log_config"
```

## sample.yaml
```
sample:
  name: watchdog timer
tests:
  samples.nrf9160.watchdogtimer:
    build_only: true
    build_on_all: false
    platform_allow: conexio_stratus_ns
    tags: ci_build
```

## prj.conf
```kconfig
#
# Copyright (c) 2020 Nordic Semiconductor ASA
# Copyright (c) 2022 Conexio Technologies, Inc
#
# SPDX-License-Identifier: LicenseRef-Nordic-5-Clause
#

# Enable logging
CONFIG_LOG=y
CONFIG_WDTIMER_LOG_LEVEL_DBG=y

# Enable watchdog timer
CONFIG_WATCHDOG=y

# Enable Zephyr application to be booted by MCUboot
CONFIG_BOOTLOADER_MCUBOOT=y
```

## src/main.c
```c
/*
 * Copyright (c) 2018 Nordic Semiconductor ASA
 * Copyright (c) 2022 Conexio Technologies, Inc
 * 
 * SPDX-License-Identifier: LicenseRef-Nordic-5-Clause
 */

#include <zephyr.h>
#include <stdio.h>
#include <drivers/uart.h>
#include <string.h>
#include <logging/log.h>
#include "watchdog.h"
#include <stdlib.h>

LOG_MODULE_REGISTER(wdtimer_app, CONFIG_WDTIMER_LOG_LEVEL);

/* Stack definition for application workqueue */
K_THREAD_STACK_DEFINE(application_stack_area,
		      CONFIG_APPLICATION_WORKQUEUE_STACK_SIZE);
static struct k_work_q application_work_q;

void main(void)
{

	LOG_INF("Stratus watchdog timer sample");

	k_work_queue_start(&application_work_q, application_stack_area,
		       K_THREAD_STACK_SIZEOF(application_stack_area),
		       CONFIG_APPLICATION_WORKQUEUE_PRIORITY, NULL);

	if (IS_ENABLED(CONFIG_WATCHDOG)) {
		watchdog_init_and_start(&application_work_q);
	}

}
```
