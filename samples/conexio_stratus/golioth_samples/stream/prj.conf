## prj.conf
```kconfig
# Application
CONFIG_GOLIOTH_SAMPLE_COMMON=y
CONFIG_GOLIOTH_SAMPLE_HARDCODED_CREDENTIALS=y

# Golioth Firmware SDK with all dependencies
CONFIG_GOLIOTH_FIRMWARE_SDK=y
CONFIG_GOLIOTH_STREAM=y

#######################################################
# nRF91xx configurations for Stratus Pro Devices
# General config
CONFIG_HEAP_MEM_POOL_SIZE=4096
CONFIG_NEWLIB_LIBC=y

# Networking
CONFIG_NET_SOCKETS_OFFLOAD=y
CONFIG_NET_IPV6=y
CONFIG_NET_IPV6_NBR_CACHE=n
CONFIG_NET_IPV6_MLD=n

# Increase native TLS socket implementation, so that it is chosen instead of
# offloaded nRF91 sockets
CONFIG_NET_SOCKETS_TLS_PRIORITY=35

# Modem library
CONFIG_NRF_MODEM_LIB=y

# LTE connectivity with network connection manager
CONFIG_NRF_MODEM_LIB_NET_IF=y
CONFIG_NRF_MODEM_LIB_NET_IF_AUTO_START=y
CONFIG_NRF_MODEM_LIB_NET_IF_AUTO_CONNECT=y
CONFIG_NET_CONNECTION_MANAGER=y
CONFIG_NET_CONNECTION_MANAGER_MONITOR_STACK_SIZE=1024

# Increased sysworkq size, due to LTE connectivity
CONFIG_SYSTEM_WORKQUEUE_STACK_SIZE=2048

# Disable options y-selected by NCS for no good reason
CONFIG_MBEDTLS_KEY_EXCHANGE_DHE_PSK_ENABLED=n
CONFIG_MBEDTLS_KEY_EXCHANGE_DHE_RSA_ENABLED=n

# MbedTLS configuration to support p-384 curve. These options
# enable using the MbedTLS built-in support for operations not
# supported by the default nRF Oberon crypto backend
CONFIG_NORDIC_SECURITY_BACKEND=n
CONFIG_MBEDTLS_LEGACY_CRYPTO_C=y

# Generate MCUboot compatible images
CONFIG_BOOTLOADER_MCUBOOT=y

# Insert your Golioth PSK and ID here
CONFIG_GOLIOTH_SAMPLE_PSK_ID="my-psk-id"
CONFIG_GOLIOTH_SAMPLE_PSK="my-psk"
```

## src/main.c
```c
/*
 * Copyright (c) 2023 Golioth, Inc.
 *
 * SPDX-License-Identifier: Apache-2.0
 */

#include <zephyr/logging/log.h>
LOG_MODULE_REGISTER(golioth_stream, LOG_LEVEL_DBG);

#include <golioth/client.h>
#include <golioth/stream.h>
#include <samples/common/sample_credentials.h>
#include <samples/common/net_connect.h>
#include <stdlib.h>
#include <string.h>
#include <zcbor_encode.h>
#include <zephyr/drivers/sensor.h>
#include <zephyr/kernel.h>

#define SYNC_TIMEOUT_S 2

struct golioth_client *client;
static K_SEM_DEFINE(connected, 0, 1);

static void on_client_event(struct golioth_client *client,
                            enum golioth_client_event event,
                            void *arg)
{
    bool is_connected = (event == GOLIOTH_CLIENT_EVENT_CONNECTED);
    if (is_connected)
    {
        k_sem_give(&connected);
    }
    LOG_INF("Golioth client %s", is_connected ? "connected" : "disconnected");
}

/* Generate simulated temperature readings */
static int get_temperature(struct sensor_value *val)
{
    static int counter = 0;

    /* generate a temperature from 20 deg to 30 deg, with 0.5 deg step */

    val->val1 = 20 + counter / 2;
    val->val2 = counter % 2 == 1 ? 500000 : 0;

    counter = (counter + 1) % 20;

    return 0;
}

static void temperature_async_push_handler(struct golioth_client *client,
                                           enum golioth_status status,
                                           const struct golioth_coap_rsp_code *coap_rsp_code,
                                           const char *path,
                                           void *arg)
{
    if (status != GOLIOTH_OK)
    {
        LOG_WRN("Failed to push temperature data: %d", status);
        return;
    }

    LOG_DBG("Temperature data successfully pushed");

    return;
}

static void temperature_push_cbor(const struct sensor_value *temp, bool async)
{
    uint8_t buf[15];
    int err;

    /* Create zcbor state variable for encoding */
    ZCBOR_STATE_E(zse, 1, buf, sizeof(buf), 1);

    /* Encode the CBOR map header */
    bool ok = zcbor_map_start_encode(zse, 1);
    if (!ok)
    {
        LOG_ERR("Failed to start encoding CBOR map");
        return;
    }

    /* Encode the map key "temp" into buf as a text string */
    ok = zcbor_tstr_put_lit(zse, "temp");
    if (!ok)
    {
        LOG_ERR("CBOR: Failed to encode temp name");
        return;
    }

    /* Encode the temperature value into buf as a float */
    ok = zcbor_float32_put(zse, sensor_value_to_float(temp));
    if (!ok)
    {
        LOG_ERR("CBOR: failed to encode temp value");
        return;
    }

    /* Close the CBOR map */
    ok = zcbor_map_end_encode(zse, 1);
    if (!ok)
    {
        LOG_ERR("Failed to close CBOR map");
        return;
    }

    size_t payload_size = (intptr_t) zse->payload - (intptr_t) buf;

    /* Empty path ("") is used to send the payload to the Stream root path */
    if (async)
    {
        err = golioth_stream_set_async(client,
                                       "",
                                       GOLIOTH_CONTENT_TYPE_CBOR,
                                       buf,
                                       payload_size,
                                       temperature_async_push_handler,
                                       NULL);
    }
    else
    {
        err = golioth_stream_set_sync(client,
                                      "",
                                      GOLIOTH_CONTENT_TYPE_CBOR,
                                      buf,
                                      payload_size,
                                      SYNC_TIMEOUT_S);
    }

    if (err)
    {
        LOG_WRN("Failed to push temperature: %d", err);
        return;
    }

    if (!async)
    {
        LOG_DBG("Temperature successfully pushed");
    }
}

int main(void)
{
    struct sensor_value temp;
    int err;

    LOG_DBG("Start Golioth stream sample for %s", CONFIG_BOARD);

    net_connect();

    /* Note: In production, you would provision unique credentials onto each
     * device. For simplicity, we provide a utility to hardcode credentials as
     * kconfig options in the samples.
     */
    const struct golioth_client_config *client_config = golioth_sample_credentials_get();

    client = golioth_client_create(client_config);
    golioth_client_register_event_callback(client, on_client_event, NULL);

    k_sem_take(&connected, K_FOREVER);

    while (true)
    {
        /* Callback-based using CBOR map */
        err = get_temperature(&temp);
        if (err)
        {
            k_sleep(K_SECONDS(1));
            continue;
        }

        LOG_INF("Sending temperature %d.%06d (async)", temp.val1, abs(temp.val2));

        temperature_push_cbor(&temp, true);

        k_sleep(K_SECONDS(10));
    }

    return 0;
}
```
