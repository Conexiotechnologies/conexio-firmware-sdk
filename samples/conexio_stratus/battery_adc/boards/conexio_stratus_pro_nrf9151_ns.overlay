/*
 * Copyright (c) 2024 Conexio Technologies, Inc
 *
 * SPDX-License-Identifier: Apache-2.0
 */

#include <samples/cellular/nrf91_bootloader_partitions.dtsi>
#include <samples/cellular/nrf91_sram_partitions.dtsi>

/ {
	zephyr,user {
		/* Battery voltage is measured directly via the internal VDD
		 * reference (SAADC_CH_PSELP_PSELP_VDD) when no voltage divider
		 * is present. io-channels must be declared to satisfy the
		 * DT_IO_CHANNELS_INPUT(ZEPHYR_USER) macro in battery.c.
		 */
		io-channels = <&adc 0>;
	};
};
