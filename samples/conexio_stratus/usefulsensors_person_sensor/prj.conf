## CMakeLists.txt
```
#
# Copyright (c) 2024 Conexio Technologies, Inc
#

cmake_minimum_required(VERSION 3.20.0)

find_package(Zephyr REQUIRED HINTS $ENV{ZEPHYR_BASE})
project(usefulsensors)

target_sources(app PRIVATE src/main.c)
```

## Kconfig
```
#
# Copyright (c) 2024 Conexio Technologies, Inc
#
#

menu "Zephyr Kernel"
source "Kconfig.zephyr"
endmenu

module = USEFULSENSORS
module-str = app
source "${ZEPHYR_BASE}/subsys/logging/Kconfig.template.log_config"
```

## prj.conf
```kconfig
#
# Copyright (c) 2024 Conexio Technologies, Inc
#
# SPDX-License-Identifier: Apache-2.0
#

# For enabling serial output
CONFIG_SERIAL=y

# For enabling I2C driver
CONFIG_I2C=y

# For printing floating point values
CONFIG_CBPRINTF_FP_SUPPORT=y

# Sensor Log level
# For more verbose and detailed log output, set the log level to y
CONFIG_LOG=y
CONFIG_USEFULSENSORS_LOG_LEVEL_INF=y

# Enable Zephyr application to be booted by MCUboot
CONFIG_BOOTLOADER_MCUBOOT=y
```

## src/main.c
```c
/*---------------------------------------------------------------------------*/
/*
 * Copyright (c) 2025 Conexio Technologies, Inc.
 * Author: Rajeev Piyare <rajeev@conexiotech.com>
 *
 * SPDX-License-Identifier: Apache-2.0
 */  
/*---------------------------------------------------------------------------*/
#include <stdio.h>
#include <zephyr/device.h>
#include <zephyr/drivers/i2c.h>
#include <zephyr/drivers/sensor.h>
#include <zephyr/logging/log.h>
#include "person_sensor.h"
/*---------------------------------------------------------------------------*/
/* Register the logging module */
LOG_MODULE_REGISTER(app, CONFIG_USEFULSENSORS_LOG_LEVEL);
/*---------------------------------------------------------------------------*/
const struct device *i2c_device;
/*---------------------------------------------------------------------------*/
static int rc;
static int i;
/*---------------------------------------------------------------------------*/
// How long to wait between sensor sampling. The sensor can be read as
// frequently as you like, but the results only change at about 5FPS, so
// waiting for >200ms is reasonable. Here, we are waiting for 1 sec. 
#define SAMPLING_INTERVAL_MS   (K_MSEC(1000))
/*---------------------------------------------------------------------------*/
/*
 * Brief : Fetch the latest results from the sensor
 * Param ; Pointer to the results
 * Return : false if the read didn't succeed.
 */
bool person_sensor_read(person_sensor_results_t* results) {
    rc = i2c_read(i2c_device, (uint8_t*)(results), sizeof(person_sensor_results_t), PERSON_SENSOR_I2C_ADDRESS);
    if (rc < 0) {
        LOG_ERR("i2c_read error: %d", rc);
        return false;
	} else {
        return true;
    }
}
/*---------------------------------------------------------------------------*/
/*
 * Brief : Writes the value to the sensor register
 * Param1 : Register address
 * Param2 : values to be written
 * Return : void
 */
void person_sensor_write_reg(uint8_t reg, uint8_t value) {
    uint8_t write_bytes[2] = {reg, value};

    rc = i2c_write(i2c_device, write_bytes, sizeof(write_bytes), PERSON_SENSOR_I2C_ADDRESS);
    if (rc < 0) {
        LOG_ERR("i2c_write error: %d", rc);
	}
}
/*---------------------------------------------------------------------------*/
/*
 * Brief : Initialize the I2C bus
 * Param : I2C device 
 * Return : -EINVAL if failed, else 0 if Successful
 */
static int i2c_init(void) {
    LOG_INF("Setting up i2c");

    // For Stratus Pro its i2c2 and for Stratus Gen 1 its i2c1
    i2c_device = DEVICE_DT_GET(DT_NODELABEL(i2c2));

    if (!device_is_ready(i2c_device)) {
		LOG_ERR("I2C: Device is not ready");
		return -EINVAL;
	}

    int ret = i2c_configure(i2c_device, I2C_SPEED_SET(I2C_SPEED_FAST));
    if (ret < 0 )
    {
        LOG_ERR("I2C: Configuration failed");
        return ret;
    }

    return 0;
}
/*---------------------------------------------------------------------------*/
int main(void) 
{
    LOG_INF("Usefulsensors person sensor sample started on %s\n", CONFIG_BOARD); 
    person_sensor_results_t results = {};

    i2c_init();
    
    while (1)
    {
        // Perform a read action on the I2C address of the sensor to get the
        // current face information detected.
        if (!person_sensor_read(&results)) 
        {
            LOG_ERR("No person sensor results found on the i2c bus");
            k_sleep(SAMPLING_INTERVAL_MS);
            return 0;
        }

        LOG_INF("****************");
        LOG_INF("%d face(s) found", results.num_faces);

        for (i = 0; i < results.num_faces; ++i) 
        {
            const person_sensor_face_t* face = &results.faces[i];

            LOG_INF("Face #%d: %d confidence, (%d, %d), (%d, %d), %s",
            i, face->box_confidence, face->box_left, face->box_top,
            face->box_right, face->box_bottom, 
            face->is_facing ? "facing" : "not facing");
        }
        k_sleep(SAMPLING_INTERVAL_MS);
    }
}
/*---------------------------------------------------------------------------*/
```

## src/person_sensor.h
```c
/*---------------------------------------------------------------------------*/
#ifndef INCLUDE_PERSON_SENSOR_H
#define INCLUDE_PERSON_SENSOR_H
/*---------------------------------------------------------------------------*/
// Definitions for the Useful Sensors Person Sensor module.
// Includes the standard I2C address of the sensor, constants for the
// configuration commands, and the data structures used to communicate results
// to the main system.
// See the full developer guide at https://usfl.ink/ps_dev for more information.
/*---------------------------------------------------------------------------*/
#include <stdint.h>
/*---------------------------------------------------------------------------*/
// The I2C address of the person sensor board.
#define PERSON_SENSOR_I2C_ADDRESS           (0x62)
/*---------------------------------------------------------------------------*/
// Configuration commands for the sensor. Write this as a byte to the I2C bus
// followed by a second byte as an argument value.
#define PERSON_SENSOR_REG_MODE             (0x01)
#define PERSON_SENSOR_REG_ENABLE_ID        (0x02)
#define PERSON_SENSOR_REG_SINGLE_SHOT      (0x03)
#define PERSON_SENSOR_REG_CALIBRATE_ID     (0x04)
#define PERSON_SENSOR_REG_PERSIST_IDS      (0x05)
#define PERSON_SENSOR_REG_ERASE_IDS        (0x06)
#define PERSON_SENSOR_REG_DEBUG_MODE       (0x07)
/*---------------------------------------------------------------------------*/
// The person sensor will never output more than four faces.
#define PERSON_SENSOR_MAX_FACES_COUNT (4)
/*---------------------------------------------------------------------------*/
// How many different faces the sensor can recognize.
#define PERSON_SENSOR_MAX_IDS_COUNT (7)
/*---------------------------------------------------------------------------*/
// The following structures represent the data format returned from the person
// sensor over the I2C communication protocol. The C standard doesn't
// guarantee the byte-wise layout of a regular struct across different
// platforms, so we add the non-standard (but widely supported) __packed__
// attribute to ensure the layouts are the same as the wire representation.

// The results returned from the sensor have a short header providing
// information about the length of the data packet:
//   reserved: Currently unused bytes.
//   data_size: Length of the entire packet, excluding the header and checksum.
//     For version 1.0 of the sensor, this should be 40.
typedef struct __attribute__ ((__packed__)) {
    uint8_t reserved[2];  // Bytes 0-1.
    uint16_t data_size;   // Bytes 2-3.
} person_sensor_results_header_t;
/*---------------------------------------------------------------------------*/
// Each face found has a set of information associated with it:
//   box_confidence: How certain we are we have found a face, from 0 to 255.
//   box_left: X coordinate of the left side of the box, from 0 to 255.
//   box_top: Y coordinate of the top edge of the box, from 0 to 255.
//   box_width: Width of the box, where 255 is the full view port size.
//   box_height: Height of the box, where 255 is the full view port size.
//   id_confidence: How sure the sensor is about the recognition result.
//   id: Numerical ID assigned to this face.
//   is_looking_at: Whether the person is facing the camera, 0 or 1.
typedef struct __attribute__ ((__packed__)) {
    uint8_t box_confidence;   // Byte 1.
    uint8_t box_left;         // Byte 2.
    uint8_t box_top;          // Byte 3.
    uint8_t box_right;        // Byte 4.
    uint8_t box_bottom;       // Byte 5.
    int8_t id_confidence;     // Byte 6.
    int8_t id;                // Byte 7
    uint8_t is_facing;        // Byte 8.
} person_sensor_face_t;
/*---------------------------------------------------------------------------*/
// This is the full structure of the packet returned over the wire from the
// sensor when we do an I2C read from the peripheral address.
// The checksum should be the CRC16 of bytes 0 to 38. You shouldn't need to
// verify this in practice, but we found it useful during our own debugging.
typedef struct __attribute__ ((__packed__)) {
    person_sensor_results_header_t header;                     // Bytes 0-4.
    int8_t num_faces;                                          // Byte 5.
    person_sensor_face_t faces[PERSON_SENSOR_MAX_FACES_COUNT]; // Bytes 6-37.
    uint16_t checksum;                                         // Bytes 38-39.
} person_sensor_results_t;
/*---------------------------------------------------------------------------*/
#endif  // INCLUDE_PERSON_SENSOR_H
/*---------------------------------------------------------------------------*/
```
