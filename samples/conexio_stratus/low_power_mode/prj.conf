## CMakeLists.txt
```
#
# Copyright (c) 2025 Conexio Technologies, Inc.
#
# SPDX-License-Identifier: Apache-2.0
#

cmake_minimum_required(VERSION 3.20.0)

find_package(Zephyr REQUIRED HINTS $ENV{ZEPHYR_BASE})
project(lpm)

target_sources(app PRIVATE src/main.c)

zephyr_include_directories(src)
```

## sample.yaml
```
sample:
  name: LPM sample
```

## prj.conf
```kconfig
#
# Copyright (c) 2025 Conexio Technologies, Inc.
##

# General config
CONFIG_SERIAL=n
CONFIG_LOG=n
CONFIG_GPIO=y
CONFIG_NRF_MODEM_LIB=y
CONFIG_LTE_LINK_CONTROL=y
CONFIG_POWEROFF=y

# Enable Zephyr application to be booted by MCUBoot
CONFIG_BOOTLOADER_MCUBOOT=y
```

## boards/conexio_stratus_pro_nrf9161_ns.overlay
```dts
/*
 * Copyright (c) 2024 Conexio Technologies, Inc
 *
 * SPDX-License-Identifier: Apache-2.0
 */

 &uart0 {
	status = "okay";
	current-speed = <115200>;
	/delete-property/ rx-pin;
};
```

## src/main.c
```c
/*
 * Copyright (c) 2025 Conexio Technologies, Inc.
 * Author: Rajeev Piyare <rajeev@conexiotech.com>
 *
 * SPDX-License-Identifier: Apache-2.0
 */

#include <stdio.h>
#include <zephyr/kernel.h>
#include <modem/lte_lc.h>
#include <modem/nrf_modem_lib.h>
#include <zephyr/sys/poweroff.h>

int main(void)
{
	int err;

	printk("Low Power Mode sample has started\n");

	err = nrf_modem_lib_init();
	if (err) {
		printk("Failed to initialize modem library, error: %d\n", err);
		return -1;
	}

	/* Turn LTE power off */
	lte_lc_power_off();

	k_sleep(K_MSEC(1000));

	/* Shut down the nRF91 regulator */
	NRF_REGULATORS->SYSTEMOFF = 1;
	
	/* Shut down modem library */
	err = nrf_modem_lib_shutdown();
	if (err) {
		return -1;
	}

	/* Finally poweroff the system safely */
	sys_poweroff();

	return 0;
}
```
