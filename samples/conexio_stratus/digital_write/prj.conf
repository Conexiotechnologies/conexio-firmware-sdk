## CMakeLists.txt
```
# SPDX-License-Identifier: Apache-2.0

cmake_minimum_required(VERSION 3.20.0)
find_package(Zephyr HINTS $ENV{ZEPHYR_BASE})
project(digital_write)

target_sources(app PRIVATE src/main.c)
```

## prj.conf
```kconfig
#
# Copyright (c) 2025 Conexio Technologies, Inc
#
# SPDX-License-Identifier: Apache-2.0
#

CONFIG_GPIO=y
CONFIG_LOG=y

# Enable Zephyr application to be booted by MCUboot
CONFIG_BOOTLOADER_MCUBOOT=y
```

## boards/conexio_stratus_pro_nrf9151_ns.overlay
```dts
/*
 * Copyright (c) 2025 Conexio Technologies, Inc
 *
 * SPDX-License-Identifier: Apache-2.0
 */

/ {
    aliases {
        gpiopin = &gpioctrl;
    };
    gpio_keys {
        compatible = "gpio-keys";
        gpioctrl: gpio_ctrl {
            gpios = <&gpio0 24 GPIO_ACTIVE_LOW>;
        };
    };
};
```

## src/main.c
```c
/*
 * Copyright (c) 2024 Conexio Technologies, Inc
 *
 * SPDX-License-Identifier: Apache-2.0
 */

#include <zephyr/kernel.h>
#include <zephyr/device.h>
#include <stdio.h>
#include <zephyr/drivers/gpio.h>

#define PINOUT DT_ALIAS(gpiopin)
static struct gpio_dt_spec output_pin = GPIO_DT_SPEC_GET(PINOUT, gpios);

int main(void)
{
	printf("Gpio output sample running on %s\n", CONFIG_BOARD);

	// Configure gpio pin as output and low
	gpio_pin_configure_dt(&output_pin, GPIO_OUTPUT_INACTIVE);

	while (true)
	{
		gpio_pin_set_dt(&output_pin, 1);
		k_sleep(K_MSEC(2000));
		gpio_pin_set_dt(&output_pin, 0);
	}
}
```
