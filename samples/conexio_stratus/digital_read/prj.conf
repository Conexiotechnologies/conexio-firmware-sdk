## CMakeLists.txt
```
# SPDX-License-Identifier: Apache-2.0

cmake_minimum_required(VERSION 3.20.0)
# Override BOARD_ROOT to always point at this SDK's boards/ directory.
# Using CACHE FORCE ensures this wins over any -DBOARD_ROOT passed by the IDE
# or build system, preventing "board defined multiple times" errors when
# multiple SDK versions are present in the environment.
set(BOARD_ROOT "${CMAKE_CURRENT_SOURCE_DIR}/../../.." CACHE PATH "" FORCE)

find_package(Zephyr HINTS $ENV{ZEPHYR_BASE})
project(digital_read)

target_sources(app PRIVATE src/main.c)
```

## prj.conf
```kconfig
#
# Copyright (c) 2025 Conexio Technologies, Inc
#
# SPDX-License-Identifier: Apache-2.0
#

CONFIG_GPIO=y
CONFIG_LOG=y

# Enable Zephyr application to be booted by MCUboot
CONFIG_BOOTLOADER_MCUBOOT=y

# TF-M minimal profile (required when not using full TF-M PS/ITS/OTP storage)
CONFIG_TFM_PROFILE_TYPE_MINIMAL=y
```

## boards/conexio_stratus_pro_nrf9151_ns.overlay
```dts
/*
 * Copyright (c) 2025 Conexio Technologies, Inc
 *
 * SPDX-License-Identifier: Apache-2.0
 */

/ {
	aliases {
		pininput = &input_gpio;
	};

	gpio_keys {
		compatible = "gpio-keys";
		input_gpio: input_gpio {
			gpios = <&gpio0 18 (GPIO_PULL_UP | GPIO_ACTIVE_LOW)>;
			/* GPIO_PULL_UP | GPIO_ACTIVE_LOW assumes the pin is pulled up 
			* and active when grounded. You can change it to GPIO_ACTIVE_HIGH if needed.
			*/
		};
	};
};
```

## boards/conexio_stratus_pro_nrf9161_ns.overlay
```dts
/*
 * Copyright (c) 2025 Conexio Technologies, Inc
 *
 * SPDX-License-Identifier: Apache-2.0
 */


#include <samples/cellular/nrf91_bootloader_partitions.dtsi>
#include <samples/cellular/nrf91_sram_partitions.dtsi>

/ {
	aliases {
		pininput = &input_gpio;
	};

	gpio_keys {
		compatible = "gpio-keys";
		input_gpio: input_gpio {
			gpios = <&gpio0 18 (GPIO_PULL_UP | GPIO_ACTIVE_LOW)>;
			/* GPIO_PULL_UP | GPIO_ACTIVE_LOW assumes the pin is pulled up 
			* and active when grounded. You can change it to GPIO_ACTIVE_HIGH if needed.
			*/
		};
	};
};
```

## src/main.c
```c
/*
 * Copyright (c) 2025 Conexio Technologies, Inc.
 * Author: Rajeev Piyare <rajeev@conexiotech.com>
 *
 * SPDX-License-Identifier: Apache-2.0
 */
#include <zephyr/kernel.h>
#include <zephyr/device.h>
#include <zephyr/devicetree.h>
#include <zephyr/drivers/gpio.h>
#include <zephyr/logging/log.h>

LOG_MODULE_REGISTER(main);

#define SLEEP_TIME_MS 1000

#define INPUT_NODE DT_ALIAS(pininput)
static const struct gpio_dt_spec input_pin = GPIO_DT_SPEC_GET_OR(INPUT_NODE, gpios, {0});

int main(void)
{
    int ret;

    if (!device_is_ready(input_pin.port))
    {
        LOG_ERR("GPIO device not ready");
        return 1;
    }

    ret = gpio_pin_configure_dt(&input_pin, GPIO_INPUT);
    if (ret != 0)
    {
        LOG_ERR("Failed to configure input pin (err %d)", ret);
        return 1;
    }

    while (1)
    {
        int val = gpio_pin_get_dt(&input_pin);
        if (val < 0)
        {
            LOG_ERR("Error reading input pin value: %d", val);
        }
        else
        {
            LOG_INF("GPIO P0.18 state: %d\n", val);
        }

        k_msleep(SLEEP_TIME_MS);
    }

    return 0; // not reached
}
```
