/*
 * Copyright (c) 2025 Conexio Technologies, Inc
 *
 * SPDX-License-Identifier: Apache-2.0
 */

/ {
	aliases {
		pininput = &input_gpio;
	};

	gpio_keys {
		compatible = "gpio-keys";
		input_gpio: input_gpio {
			gpios = <&gpio0 18 (GPIO_PULL_UP | GPIO_ACTIVE_LOW)>;
			/* GPIO_PULL_UP | GPIO_ACTIVE_LOW assumes the pin is pulled up 
			* and active when grounded. You can change it to GPIO_ACTIVE_HIGH if needed.
			*/
		};
	};
};
