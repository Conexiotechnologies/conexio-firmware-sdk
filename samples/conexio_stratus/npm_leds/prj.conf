## CMakeLists.txt
```
# Copyright (c) 2025 Conexio Technologies, Inc
# SPDX-License-Identifier: LicenseRef-Nordic-5-Clause

cmake_minimum_required(VERSION 3.20.0)

find_package(Zephyr REQUIRED HINTS $ENV{ZEPHYR_BASE})

project(npm_leds)

target_sources(app PRIVATE src/main.c)
```

## Kconfig
```
#
# Copyright (c) 2025 Conexio Technologies, Inc
#
# SPDX-License-Identifier: LicenseRef-Nordic-5-Clause
#
menu "nPM1300 LEDs sample"

config NPM_LEDS_BLINK_INTERVAL_MS
	int "LED blink interval in milliseconds"
	default 500
	help
	  Interval in milliseconds between LED state changes when in host mode.

endmenu

menu "Zephyr Kernel"
source "Kconfig.zephyr"
endmenu
```

## sample.yaml
```
# Copyright (c) 2025 Conexio Technologies, Inc
# SPDX-License-Identifier: LicenseRef-Nordic-5-Clause
sample:
  name: nPM1300 LEDs

common:
  tags: pmic led

tests:
  samples.npm_leds:
    platform_allow: conexio_stratus_pro_nrf9151_ns
    harness: console
    harness_config:
      type: multi_line
      ordered: true
      regex:
        - "nPM1300 LED sample running"
        - "LED.*ON"
```

## prj.conf
```kconfig
# Copyright (c) 2025 Conexio Technologies, Inc
# SPDX-License-Identifier: LicenseRef-Nordic-5-Clause

CONFIG_LOG=y
CONFIG_PRINTK=y

# GPIO and I2C support
CONFIG_GPIO=y
CONFIG_I2C=y

# MFD and regulator support required by nPM1300
CONFIG_MFD=y
CONFIG_REGULATOR=y

# LED driver - auto-enabled via DT, but explicit for clarity
CONFIG_LED=y
CONFIG_LED_NPM13XX=y

CONFIG_MAIN_STACK_SIZE=1536

# Enable MCUboot bootloader support
CONFIG_BOOTLOADER_MCUBOOT=y
```

## boards/conexio_stratus_pro_nrf9151_ns.overlay
```dts
/*
 * Copyright (c) 2025 Conexio Technologies, Inc
 *
 * SPDX-License-Identifier: LicenseRef-Nordic-5-Clause
 */

/*
 * Pull up I2C2 lines — required for reliable nPM1300 communication.
 */
&i2c2_default {
	group1 {
		bias-pull-up;
	};
};

/*
 * Add the nPM1300 LED controller as a child of pmic_main.
 *
 * LED modes:
 *   charging — automatically driven by the charger state machine
 *   error    — automatically driven by the PMIC error logic
 *   host     — fully software-controlled via the Zephyr LED API
 *
 * LED0: charging indicator (auto)
 * LED1: error indicator    (auto)
 * LED2: host / user LED    (software-controlled — used for blinking in main.c)
 */
&pmic_main {
	npm1300_leds: leds {
		compatible = "nordic,npm1300-led";
		nordic,led0-mode = "charging";
		nordic,led1-mode = "error";
		nordic,led2-mode = "host";
	};
};
```

## src/main.c
```c
/*
 * Copyright (c) 2025 Conexio Technologies, Inc
 * Author: Rajeev Piyare <rajeev@conexiotech.com>
 *
 * SPDX-License-Identifier: LicenseRef-Nordic-5-Clause
 *
 * nPM1300 LED sample for Conexio Stratus Pro (nRF9151)
 *
 * The nPM1300 exposes three LED outputs:
 *   LED0 — "charging" mode: driven automatically by the charger state machine
 *   LED1 — "error"    mode: driven automatically by PMIC error conditions
 *   LED2 — "host"     mode: fully software-controlled via the Zephyr LED API
 *
 * This sample demonstrates:
 *   1. How to obtain the nPM1300 LED device from the devicetree.
 *   2. How to turn individual LEDs on/off using led_on() / led_off().
 *   3. A simple blink pattern that sequences through all three LEDs and
 *      then blinks LED2 (host-mode) continuously.
 *
 * Note: led_on() / led_off() only have an observable effect on LEDs
 * configured in "host" mode. Calls on LEDs in "charging" or "error"
 * mode return -ENOTSUP and are safely ignored here.
 */

#include <zephyr/kernel.h>
#include <zephyr/device.h>
#include <zephyr/drivers/led.h>
#include <zephyr/sys/printk.h>
#include <zephyr/logging/log.h>

LOG_MODULE_REGISTER(npm_leds, LOG_LEVEL_INF);

/* Devicetree node for the nPM1300 LED controller */
#define NPM1300_LEDS_NODE DT_NODELABEL(npm1300_leds)

/* LED indices matching the DT definition order */
#define LED0_CHARGING 0U   /* "charging" mode — auto-controlled */
#define LED1_ERROR    1U   /* "error"    mode — auto-controlled */
#define LED2_HOST     2U   /* "host"     mode — software-controlled */

/* Blink interval from Kconfig (default 500 ms) */
#define BLINK_MS CONFIG_NPM_LEDS_BLINK_INTERVAL_MS

static const struct device *led_dev = DEVICE_DT_GET(NPM1300_LEDS_NODE);

/**
 * @brief Try to turn a LED on, log result.
 *
 * LEDs in "charging" or "error" mode will return -ENOTSUP — this is
 * expected and logged as informational rather than an error.
 */
static void led_set(uint32_t idx, bool on)
{
	int ret = on ? led_on(led_dev, idx) : led_off(led_dev, idx);

	if (ret == 0) {
		LOG_INF("LED%u %s", idx, on ? "ON" : "OFF");
	} else if (ret == -ENOTSUP) {
		LOG_INF("LED%u is in auto mode (charging/error), skipping software control", idx);
	} else {
		LOG_ERR("LED%u %s failed: %d", idx, on ? "on" : "off", ret);
	}
}

/**
 * @brief Turn the user LED (LED2, host mode) on or off.
 *
 * This is the intended entry point for application code that wants to
 * use the nPM1300 LED2 output as a general-purpose status indicator.
 *
 * @param on  true to turn LED2 on, false to turn it off.
 */
static void user_led_set(bool on)
{
	led_set(LED2_HOST, on);
}

/**
 * @brief Sequence all three LEDs on then off, one at a time.
 */
static void led_chase_sequence(void)
{
	LOG_INF("--- Chase sequence: LED0 -> LED1 -> LED2 ---");

	for (uint32_t i = 0; i < 3; i++) {
		led_set(i, true);
		k_msleep(BLINK_MS);
		led_set(i, false);
		k_msleep(BLINK_MS / 2);
	}
}

int main(void)
{
	printk("nPM1300 LED sample running on %s\n", CONFIG_BOARD);

	if (!device_is_ready(led_dev)) {
		LOG_ERR("nPM1300 LED device not ready");
		return -ENODEV;
	}

	LOG_INF("nPM1300 LED device ready");
	LOG_INF("LED0 = charging (auto), LED1 = error (auto), LED2 = host (software)");

	/*
	 * Run one pass of the chase sequence so all three outputs are
	 * exercised — useful for board bring-up / visual confirmation.
	 */
	led_chase_sequence();

	k_msleep(1000);

	/*
	 * Main loop: blink LED2 (host mode) continuously.
	 * LED0 and LED1 are managed automatically by the PMIC hardware.
	 */
	LOG_INF("Starting continuous blink on LED2 (host mode)");

	bool state = false;

	while (1) {
		state = !state;
		user_led_set(state);
		k_msleep(BLINK_MS);
	}

	return 0;
}
```
