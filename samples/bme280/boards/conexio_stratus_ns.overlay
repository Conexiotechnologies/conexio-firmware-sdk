/*
 * Copyright (c) 2021 Conexio Technologies, Inc
 *
 * SPDX-License-Identifier: Apache-2.0
 */

/*
 * Example configuration of a BME280 MIKROE-1978 Click board on Stratus Shield I2C bus.
 *
 * Device address is 0x76. Your device may have a different
 * address; check your device documentation if unsure.
 */
&i2c1 {
	status = "okay";
	bme280@76 {
		compatible = "bosch,bme280";
		reg = <0x76>;
		label = "BME280";
	};
};
