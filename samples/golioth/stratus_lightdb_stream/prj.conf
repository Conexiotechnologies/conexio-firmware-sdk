## prj.conf
```kconfig
# Copyright (c) 2022 Golioth, Inc.
# Copyright (c) 2023 Conexio Technologies, Inc
# SPDX-License-Identifier: Apache-2.0

CONFIG_GOLIOTH_SAMPLES_COMMON=y

# Generic networking options
CONFIG_NETWORKING=y
CONFIG_NET_IPV4=y
CONFIG_NET_IPV6=n

# Logging
CONFIG_NET_LOG=y

# Network Shell
CONFIG_NET_SHELL=y

# TLS configuration
CONFIG_MBEDTLS_ENABLE_HEAP=y
CONFIG_MBEDTLS_HEAP_SIZE=10240
CONFIG_MBEDTLS_SSL_MAX_CONTENT_LEN=2048

# Application
CONFIG_MAIN_STACK_SIZE=4096
CONFIG_EVENTFD=y

CONFIG_GOLIOTH=y
CONFIG_GOLIOTH_SYSTEM_CLIENT=y

CONFIG_TINYCBOR=y
CONFIG_MINIMAL_LIBC_MALLOC_ARENA_SIZE=1024

# Golioth credentials
CONFIG_GOLIOTH_SYSTEM_CLIENT_PSK_ID="my-psk-id@my-project"
CONFIG_GOLIOTH_SYSTEM_CLIENT_PSK="my-psk"

CONFIG_CBPRINTF_FP_SUPPORT=y

# Enable I2C
CONFIG_I2C=y

# Enable Stratus sensors
CONFIG_SENSOR=y

# Enable SHT4X sensor
CONFIG_SHT4X=y
CONFIG_PM_DEVICE=y

# Enable system logging 
CONFIG_LOG=y
CONFIG_SENSOR_LOG_LEVEL_DBG=y

# Enable Zephyr application to be booted by MCUboot
CONFIG_BOOTLOADER_MCUBOOT=y
```

## boards/conexio_stratus_ns.conf
```kconfig
#
# Copyright (c) 2022 Golioth, Inc.
# Copyright (c) 2023 Conexio Technologies, Inc
#
# SPDX-License-Identifier: Apache-2.0

# General config
CONFIG_HEAP_MEM_POOL_SIZE=4096
CONFIG_NEWLIB_LIBC=y

# Networking
CONFIG_NET_NATIVE=n
CONFIG_NET_SOCKETS_OFFLOAD=y

# Increase native TLS socket implementation, so that it is chosen instead of
# offloaded nRF91 sockets
CONFIG_NET_SOCKETS_TLS_PRIORITY=35

# LTE link control
CONFIG_LTE_LINK_CONTROL=y
CONFIG_LTE_AUTO_INIT_AND_CONNECT=y

# Modem library
CONFIG_NRF_MODEM_LIB=y

# Use NCS fork of mbedTLS, as Zephyr built-in mbedTLS integration (CONFIG_MBEDTLS_BUILTIN) is in
# conflict with CONFIG_NRF_SECURITY
CONFIG_MBEDTLS_TLS_LIBRARY=y
CONFIG_MBEDTLS_SSL_PROTO_DTLS=y
CONFIG_MBEDTLS_GCM_C=y
# ... and disable options y-selected by NCS for no good reason
CONFIG_MBEDTLS_KEY_EXCHANGE_DHE_PSK_ENABLED=n
CONFIG_MBEDTLS_KEY_EXCHANGE_DHE_RSA_ENABLED=n
# ... also increase heap size to "high enough to make it work"
CONFIG_MBEDTLS_HEAP_SIZE=49152
```

## src/main.c
```c
/*--------------------------------------------------------------------------*/
/*
 * Copyright (c) 2021 Golioth, Inc.
 * Copyright (c) 2023 Conexio Technologies, Inc
 *
 * SPDX-License-Identifier: Apache-2.0
 */
/*--------------------------------------------------------------------------*/
#include <net/golioth/system_client.h>
#include <samples/common/net_connect.h>
#include <zephyr/net/coap.h>

#include <zephyr/device.h>
#include <zephyr/drivers/sensor.h>
#include <zephyr/drivers/sensor/sht4x.h>
#include <stdlib.h>

#include <zephyr/logging/log.h>
LOG_MODULE_REGISTER(golioth_lightdb_stream, LOG_LEVEL_DBG);
/*--------------------------------------------------------------------------*/
#if !DT_HAS_COMPAT_STATUS_OKAY(sensirion_sht4x)
#error "No sensirion,sht4x compatible node found in the device tree"
#endif
/*--------------------------------------------------------------------------*/
static struct golioth_client *client = GOLIOTH_SYSTEM_CLIENT_GET();
static struct sensor_value temp, hum;

static K_SEM_DEFINE(connected, 0, 1);
/*--------------------------------------------------------------------------*/
static void golioth_on_connect(struct golioth_client *client)
{
	k_sem_give(&connected);
}
/*--------------------------------------------------------------------------*/
static void fetch_sensor_data(const struct device *sensor)
{
	if (sensor_sample_fetch(sensor)) {
		LOG_ERR("Failed to fetch sample from SHT4X device\n");
		return;
	}

	sensor_channel_get(sensor, SENSOR_CHAN_AMBIENT_TEMP, &temp);
	sensor_channel_get(sensor, SENSOR_CHAN_HUMIDITY, &hum);
}
/*--------------------------------------------------------------------------*/
static int env_data_push_handler(struct golioth_req_rsp *rsp)
{
	if (rsp->err) {
		LOG_ERR("Failed to push data: %d", rsp->err);
		return rsp->err;
	}

	LOG_DBG("Data successfully pushed to the Golioth Cloud");

	return 0;
}
/*--------------------------------------------------------------------------*/
/*
 * This function sends SHT4X data to lightdb stream path `/environment` 
 * using callback mode (golioth_stream_push_cb).
 */
static void env_data_push_async(uint32_t tempDec, uint32_t tempFloat, uint32_t humDec, uint32_t humFloat)
{
	char sbuf[60];
	int err;
    
	/* Format the environmetal data to JSON */
	snprintk(sbuf, sizeof(sbuf) - 1, "{\"temp\":%d.%06d,\"humidity\":%d.%06d}",
		      tempDec, abs(tempFloat), humDec, abs(humFloat));

	err = golioth_stream_push_cb(client, "environment",
				     GOLIOTH_CONTENT_FORMAT_APP_JSON,
				     sbuf, strlen(sbuf),
				     env_data_push_handler, NULL);
	if (err) {
		LOG_ERR("Failed to push send sensor data: %d", err);
		return;
	}
}
/*--------------------------------------------------------------------------*/
/*
 * This function sends SHT4X data to lightdb stream path `/environment` 
 * using Synchronous mode (golioth_stream_push).
 */
static void env_data_push_sync(uint32_t tempDec, uint32_t tempFloat, uint32_t humDec, uint32_t humFloat)
{
	char sbuf[60];
	int err;
    
	/* Format the environmetal data to JSON */
	snprintk(sbuf, sizeof(sbuf) - 1, "{\"temp\":%d.%06d,\"humidity\":%d.%06d}",
		      tempDec, abs(tempFloat), humDec, abs(humFloat));

	err = golioth_stream_push(client, "environment",
				  GOLIOTH_CONTENT_FORMAT_APP_JSON,
				  sbuf, strlen(sbuf));
	if (err) {
		LOG_ERR("Failed to push send sensor data: %d", err);
		return;
	}

	LOG_INF("Environmental data successfully pushed");
}
/*--------------------------------------------------------------------------*/
void main(void)
{
	LOG_INF("Stratus < > Golioth Light DB sensor stream sample started");

	const struct device *sht = DEVICE_DT_GET_ANY(sensirion_sht4x);
	
	if (!device_is_ready(sht)) {
		LOG_ERR("Device %s is not ready.\n", sht->name);
		return;
	}

	if (IS_ENABLED(CONFIG_GOLIOTH_SAMPLES_COMMON)) {
		net_connect();
	}

	client->on_connect = golioth_on_connect;
	golioth_system_client_start();

	k_sem_take(&connected, K_FOREVER);

	while (true) {
		
		/* Fetch latest environmental data from SHT4X sensor */
		fetch_sensor_data(sht);
        
		/* Send data using Synchronous mode */
		LOG_DBG("Sending temp: %d.%06d; humidity: %d.%06d", 
			temp.val1, abs(temp.val2), hum.val1, abs(hum.val2));

		env_data_push_sync(temp.val1, temp.val2, hum.val1, hum.val2);

		k_sleep(K_SECONDS(5));

		/* Send data using Callback-based */
		LOG_DBG("Sending temp: %d.%06d; humidity: %d.%06d", 
			temp.val1, abs(temp.val2), hum.val1, abs(hum.val2));

		env_data_push_async(temp.val1, temp.val2, hum.val1, hum.val2);

		k_sleep(K_SECONDS(5));
	}
}
/*--------------------------------------------------------------------------*/
```
