## boards/conexio/stratus/Kconfig.conexio_stratus
```kconfig
# Conexio Stratus configuration

# Copyright (c) 2024 Conexio Technologies, Inc
# SPDX-License-Identifier: Apache-2.0

config BOARD_CONEXIO_STRATUS
	select SOC_NRF9160_SICA
```

## boards/conexio/stratus/board.yml
```yaml
board:
  name: conexio_stratus
  vendor: conexio
  socs:
  - name: nrf9160
    variants:
    - name: 'ns'
```

## boards/conexio/stratus_pro/Kconfig.conexio_stratus_pro
```kconfig
# CONEXIO STRATUS PRO board configuration

# Copyright (c) 2024 Conexio Technologies, Inc
# SPDX-License-Identifier: Apache-2.0

config BOARD_CONEXIO_STRATUS_PRO
	select SOC_NRF9161_LACA
```

## boards/conexio/stratus_pro/board.yml
```yaml
board:
  name: conexio_stratus_pro
  vendor: conexio
  socs:
  - name: nrf9161
    variants:
    - name: 'ns'
```

## samples/at_client/sample.yaml
```yaml
sample:
  name: at_client Sample
tests:
  sample.nrf9160.at_client:
    build_only: true
    integration_platforms:
      - nrf9160dk_nrf9160_ns
    platform_allow: nrf9160dk_nrf9160_ns conexio_stratus_ns
    tags: ci_build
```

## samples/bluetooth/led_blink/Kconfig
```kconfig
#
# Copyright (c) 2021 Conexio Technologies, Inc
#
# SPDX-License-Identifier: LicenseRef-Nordic-5-Clause
#
menu "LED blink sample"

config STRATUS_SHIELD
	bool "Enable stratus LED"
	default n
	help
	  Enables stratus shield Orange LED.

endmenu

menu "Zephyr Kernel"
source "Kconfig.zephyr"
endmenu
```

## samples/bluetooth/multicore/hello_world/Kconfig.sysbuild
```kconfig
#
# Copyright (c) 2023 Nordic Semiconductor ASA
#
# SPDX-License-Identifier: LicenseRef-Nordic-5-Clause
#

source "${ZEPHYR_BASE}/share/sysbuild/Kconfig"

config REMOTE_BOARD
	string "The board used for remote target"
	default "conexio_blitz_cpunet" if $(BOARD) = "conexio_blitz_cpuapp"
	default "conexio_blitz_cpunet" if $(BOARD) = "conexio_blitz_cpuapp_ns"
	default "UNKNOWN"
```

## samples/conexio_blitz/multicore/hello_world/Kconfig
```kconfig
#
# Copyright (c) 2023 Nordic Semiconductor ASA
# Copyright (c) 2024 Conexio Technologies, Inc
#
# SPDX-License-Identifier: LicenseRef-Nordic-5-Clause
#

source "Kconfig.zephyr"

config BOARD_ENABLE_CPUNET
	default y if (BOARD_CONEXIO_BLITZ_CPUAPP || BOARD_CONEXIO_BLITZ_CPUAPP_NS)
```

## samples/grove_buzzzer/sample.yaml
```yaml
sample:
  name: Buzzer Sample
tests:
  sample.basic.buzzer:
    tags: gpio
    filter:
    depends_on: gpio
    harness: buzzer
```

## samples/mqtt_control/sample.yaml
```yaml
sample:
  name: Simple MQTT
tests:
  samples.mqtt:
    build_only: true
    platform_allow: conexio_stratus_ns
    integration_platforms:
      - nrf9160dk_nrf9160_ns
      - thingy91_nrf9160_ns
      - conexio_stratus_ns
    tags: ci_build
```
